## conf/layer.conf
```bitbake
BBPATH .= ":${LAYERDIR}"

BBFILES += "${LAYERDIR}/recipes-*/*/*.bb \
            ${LAYERDIR}/recipes-*/*/*.bbappend"

BBFILE_COLLECTIONS += "solidrun-balena-n6g"
BBFILE_PATTERN_solidrun-balena-n6g := "^${LAYERDIR}/"
BBFILE_PRIORITY_solidrun-balena-n6g = "1337"

LAYERSERIES_COMPAT_solidrun-balena-n6g = "dunfell"
```

## conf/machine/solidrun-n6g.conf
```bitbake
#@TYPE: Machine
#@NAME: Solidrun solidrun-n6g
#@DESCRIPTION: Machine configuration for running on Solidsense

MACHINEOVERRIDES =. "mx6:mx6dl:mx6q:"

DEFAULTTUNE = "cortexa9thf-neon"
require conf/machine/include/imx-base.inc
require conf/machine/include/tune-cortexa9.inc

PREFERRED_PROVIDER_virtual/bootloader = "u-boot-solidsense-imx6"
PREFERRED_PROVIDER_virtual/kernel = "linux-imx"

UBOOT_MACHINE ?= "mx6cuboxi_defconfig"
UBOOT_MAKE_TARGET = "all"
UBOOT_SUFFIX = "img"
SPL_BINARY = "SPL"
WKS_FILE = "imx-uboot-spl.wks"

KERNEL_IMAGETYPE = "zImage"
KERNEL_DEVICETREE = " \
    imx6dl-hummingboard2-emmc-som-v15.dtb \
    imx6q-hummingboard2-emmc-som-v15.dtb \
"
MACHINE_FEATURES += "pci wifi bluetooth alsa irda serial usbhost"
MACHINE_ESSENTIAL_EXTRA_RDEPENDS += "linux-firmware-wl18xx ti-connectivity"

SERIAL_CONSOLE = "115200 ttymxc0"

MACHINE_ESSENTIAL_EXTRA_RDEPENDS += " \
    kernel-devicetree \
    solidrun-n6g-scripts \
"
```
